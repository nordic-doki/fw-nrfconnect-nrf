## subsys/debug/Kconfig
```kconfig
#
# Copyright (c) 2019 Nordic Semiconductor
#
# SPDX-License-Identifier: LicenseRef-BSD-5-Clause-Nordic
#

rsource "ppi_trace/Kconfig"
rsource "cpu_load/Kconfig"
rsource "rtt_lite_trace/Kconfig"
```

## subsys/debug/rtt_lite_trace/Kconfig
```kconfig
#
# Copyright (c) 2019 Nordic Semiconductor
#
# SPDX-License-Identifier: LicenseRef-BSD-5-Clause-Nordic
#

menuconfig RTT_LITE_TRACE
	bool "Enable RTT lite system tracing"
	depends on HAS_SEGGER_RTT
	select USE_SEGGER_RTT
	select RTT_CONSOLE
	select THREAD_MONITOR
	select TRACING
	select TRACING_EXTERNAL
	help
	  Enable RTT lite system tracing module which sends system tracing
	  events via RTT. It uses custom tracing format of traces that was
	  designed to have low performance impact on system. Traces have to be
	  converted to commonly used format on host side, e.g. Segger System
	  View.

if RTT_LITE_TRACE

config RTT_LITE_TRACE_IRQ
	bool "Trace IRQ enter and exit"
	select TRACING_ISR
	default y
	help
	  Put IRQ enter and exit in traces.

config RTT_LITE_TRACE_SYNCHRO
	bool "Trace threads synchronization calls"
	default y
	help
	  Put threads synchronization calls, i.e. mutex and semaphore handling
	  in traces.

config RTT_LITE_TRACE_THREAD_INFO
	bool "Trace thread name and stack information"
	default y
	select THREAD_STACK_INFO
	help
	  Put name and stack information of each thread in traces. Thread names
	  are enabled in kernel only if THREAD_NAME is set.

config RTT_LITE_TRACE_FAST_OVERFLOW_CHECK
	bool "Fast buffer overflow check"
	help
	  Do fast overflow detection. It will slightly increase trace
	  performance. It sends information needed to detect overflow once per
	  size of RTT buffer and before entering idle. If none of this happened
	  between overrun start and end of trace capturing then overflow will
	  not be detected. With this option set you should capture traces
	  a little longer, enough to make sure that all overflows were detected.

config RTT_LITE_TRACE_BUFFER_STATS
	bool "Report peak buffer usage"
	depends on !RTT_LITE_TRACE_FAST_OVERFLOW_CHECK
	help
	  Report peak RTT buffer usage.

config RTT_LITE_TRACE_PRINTF_MAX_ARGS
	int "Maximum number of arguments in formatted output"
	range 1 255
	default 6
	help
	  Set maximum number of arguments that rtt_lite_trace_printf can take.

config RTT_LITE_TRACE_FORMAT_ONCE
	bool "Send format string only once"
	default y
	help
	  Send format string only once before first use. This reduces trace
	  size and time overhead, but if capturing is not started on system
	  reset then some strings may be incorrectly formatted.

config RTT_LITE_TRACE_RTT_CHANNEL
	int "RTT channel number"
	range 1 1 if SEGGER_RTT_MAX_NUM_UP_BUFFERS <= 2
	range 1 2 if SEGGER_RTT_MAX_NUM_UP_BUFFERS = 3
	range 1 3 if SEGGER_RTT_MAX_NUM_UP_BUFFERS = 4
	range 1 4 if SEGGER_RTT_MAX_NUM_UP_BUFFERS = 5
	range 1 5 if SEGGER_RTT_MAX_NUM_UP_BUFFERS = 6
	range 1 6 if SEGGER_RTT_MAX_NUM_UP_BUFFERS = 7
	range 1 7 if SEGGER_RTT_MAX_NUM_UP_BUFFERS = 8
	default 1
	help
	  RTT channel that will be used to send tracing information. Host side
	  application will not relay on this number, but it will search channel
	  based on its name. The value must be less than
	  SEGGER_RTT_MAX_NUM_UP_BUFFERS.

choice RTT_LITE_TRACE_TIMER
	prompt "Use nRF H/W timer"
	default RTT_LITE_TRACE_TIMER1
	help
	  nRF H/W timer instance for fast and high resolution event time stamps.

config RTT_LITE_TRACE_TIMER0
	select NRFX_TIMER0
	bool "TIMER0"

config RTT_LITE_TRACE_TIMER1
	select NRFX_TIMER1
	bool "TIMER1"

config RTT_LITE_TRACE_TIMER2
	select NRFX_TIMER2
	bool "TIMER2"

config RTT_LITE_TRACE_TIMER3
	select NRFX_TIMER3
	bool "TIMER3"

config RTT_LITE_TRACE_TIMER4
	select NRFX_TIMER4
	bool "TIMER4"

endchoice

choice RTT_LITE_TRACE_BUFFER_SIZE
	prompt "RTT buffer size"
	default RTT_LITE_TRACE_BUFFER_SIZE_8KB
	help
	  Size of the RTT buffer to transfer events.

config RTT_LITE_TRACE_BUFFER_SIZE_512B
	bool "512B 64 events"

config RTT_LITE_TRACE_BUFFER_SIZE_1KB
	bool "1KB, 128 events"

config RTT_LITE_TRACE_BUFFER_SIZE_2KB
	bool "2KB, 256 events"

config RTT_LITE_TRACE_BUFFER_SIZE_4KB
	bool "4KB, 512 events"

config RTT_LITE_TRACE_BUFFER_SIZE_8KB
	bool "8KB, 1024 events"

config RTT_LITE_TRACE_BUFFER_SIZE_16KB
	bool "16KB, 2048 events"

config RTT_LITE_TRACE_BUFFER_SIZE_32KB
	bool "32KB, 4096 events"

config RTT_LITE_TRACE_BUFFER_SIZE_64KB
	bool "64KB, 8192 events"

config RTT_LITE_TRACE_BUFFER_SIZE_128KB
	bool "128KB, 16384 events"

endchoice

config TRACING_EXTERNAL_INCLUDE
	string
	default "debug/rtt_lite_trace.h"

endif # RTT_LITE_TRACE
```

## subsys/nrf_rpc/Kconfig
```kconfig
#
# Copyright (c) 2020 Nordic Semiconductor
#
# SPDX-License-Identifier: LicenseRef-BSD-5-Clause-Nordic
#

menu "nRF RPC (Remote Procedure Call) library"

if NRF_RPC

menu "Local endpoints options"

config NRF_RPC_LOCAL_EXTRA_EP_COUNT
	int "Number of extra local endpoints"
	range 1 32
	default 3
	help
	  Number of extra local endpoints. This value corresponds to endpoints
	  allocated for user threads not counting endpoints for thread pool.
	  This value must be the same as NRF_RPC_REMOTE_EXTRA_EP_COUNT on the
	  remote side.

config NRF_RPC_LOCAL_THREAD_POOL_SIZE
	int "Number of threads in local thread pool"
	range 1 31
	default 3
	help
	  Number of threads in local thread pool.
	  This value must be the same as NRF_RPC_REMOTE_THREAD_POOL_SIZE on the
	  remote side.


config NRF_RPC_LOCAL_THREAD_STACK_SIZE
	int "Stack size of thread from thread pool"
	default 1024
	help
	  Stack size for each thread in local thread pool.

config NRF_RPC_LOCAL_THREAD_PRIORITY
	int "Priority of thread from thread pool"
	default 2
	help
	  Thread priority of each thread in local thread pool.

endmenu

menu "Remote endpoints options"

config NRF_RPC_REMOTE_EXTRA_EP_COUNT
	int "Number of extra remote endpoints"
	range 1 32
	default 3
	help
	  Number of extra remote endpoints. This value corresponds to endpoints
	  allocated for user threads not counting endpoints for thread pool.
	  This value must be the same as NRF_RPC_LOCAL_EXTRA_EP_COUNT on the
	  remote side.

config NRF_RPC_REMOTE_THREAD_POOL_SIZE
	int "Number of threads in remote thread pool"
	range 1 31
	default 3
	help
	  Number of threads in remote thread pool.
	  This value must be the same as NRF_RPC_LOCAL_THREAD_POOL_SIZE on the
	  remote side.

endmenu

choice
	prompt "RPMSG device role"
	default RPMSG_REMOTE

config RPMSG_REMOTE
	bool "Remote"
	help
	  Selects RPMsg role as "Remote". The other side must be configured as
	  "Master".

config RPMSG_MASTER
	bool "Master"
	help
	  Selects RPMsg role as "Master". The other side must be configured as
	  "Remote".

endchoice

config NRF_RPC_TR_PRMSG_RX_STACK_SIZE
	int "Stack size of the rpmsg receive thread"
	default 1536
	help
	  Stack size for the thread that is responsible for receiving incoming
	  messages from rpmsg.

config NRF_RPC_TR_PRMSG_RX_PRIORITY
	int "Priority of the rpmsg receive thread"
	default -1
	help
	  Priority of the thread that is responsible for receiving incoming
	  messages from rpmsg.

module = NRF_RPC
module-str = NRF_RPC_
source "${ZEPHYR_BASE}/subsys/logging/Kconfig.template.log_config"

module = NRF_RPC_TR
module-str = NRF_RPC_TR
source "${ZEPHYR_BASE}/subsys/logging/Kconfig.template.log_config"

endif # NRF_RPC

endmenu
```

## subsys/serialization/Kconfig
```kconfig
#
# Copyright (c) 2020 Nordic Semiconductor
#
# SPDX-License-Identifier: LicenseRef-BSD-5-Clause-Nordic
#

menu "Serialization"

if RP_SERIALIZATION

config RP_OS_RSP_WAIT_TIME
	int "Remote procedure response wait time"
	default 1500
	help
	  Remote procedure wait for response maximum time in miliseconds

choice
	prompt "RPMSG device role"
	default RPMSG_REMOTE

config RPMSG_REMOTE
	bool "Remote"

config RPMSG_MASTER
	bool "Master"

endchoice

endif # RP_SERIALIZATION

endmenu
```
