## CMakeLists.txt
```
#
# Copyright (c) 2020 Nordic Semiconductor
#
# SPDX-License-Identifier: LicenseRef-BSD-5-Clause-Nordic
#
cmake_minimum_required(VERSION 3.8)

set(NRF_SUPPORTED_BOARDS
  nrf5340pdk_nrf5340_cpuapp
)

include(../../../../cmake/boilerplate.cmake)
include($ENV{ZEPHYR_BASE}/cmake/app/boilerplate.cmake NO_POLICY_SCOPE)
project(NONE)

# NORDIC SDK APP START
target_sources(app PRIVATE
  src/main.c
  src/entropy_ser.c
)
# NORDIC SDK APP END
```

## sample.yaml
```
sample:
  name: Entropy remote application core
  description: Entropy driver application core sample
tests:
  test_build:
    build_only: true
    build_on_all: true
    platform_whitelist: nrf5340pdk_nrf5340_cpuapp
```

## prj.conf
```kconfig
CONFIG_IPM=y
CONFIG_IPM_NRFX=y
CONFIG_IPM_MSG_CH_1_ENABLE=y
CONFIG_IPM_MSG_CH_1_TX=y
CONFIG_IPM_MSG_CH_0_ENABLE=y
CONFIG_IPM_MSG_CH_0_RX=y

CONFIG_HEAP_MEM_POOL_SIZE=4096

CONFIG_OPENAMP=y
CONFIG_TINYCBOR=y
CONFIG_RPMSG_MASTER=y
CONFIG_THREAD_CUSTOM_DATA=y
CONFIG_BOARD_ENABLE_CPUNET=y

CONFIG_NRF_RPC=y
CONFIG_NRF_RPC_CBOR=y
CONFIG_NRF_RPC_THREAD_STACK_SIZE=4096

CONFIG_LOG=y
CONFIG_NRF_RPC_LOG_LEVEL_INF=y
CONFIG_NRF_RPC_TR_LOG_LEVEL_INF=y
CONFIG_NRF_RPC_OS_LOG_LEVEL_INF=y

# Uncommend to allow better debugging
#CONFIG_NO_OPTIMIZATIONS=y
#CONFIG_DEBUG=y
CONFIG_USE_SEGGER_RTT=y
CONFIG_RTT_CONSOLE=y
```

## src/main.c
```c
/*
 * Copyright (c) 2020 Nordic Semiconductor ASA
 *
 * SPDX-License-Identifier: LicenseRef-BSD-5-Clause-Nordic
 */

#include <zephyr.h>

#include <nrf_rpc.h>

#include "entropy_ser.h"

#define BUFFER_LENGTH 10

static u8_t buffer[BUFFER_LENGTH];

static void result_callback(int result, u8_t *buffer, size_t length)
{
	size_t i;

	if (result) {
		printk("Entropy remote get failed: %d\n", result);
		return;
	}

	for (i = 0; i < length; i++) {
		printk("  0x%02x", buffer[i]);
	}

	printk("\n");
}

#include <SEGGER_RTT.h>

uint8_t rtt_buffer[8192];
static SEGGER_RTT_BUFFER_UP *up;

static void initialize(void)
{
	int i;

	up = &_SEGGER_RTT.aUp[1];
	up->sName = "test_rtt";
	up->pBuffer = (char *)(&rtt_buffer[0]);
	up->SizeOfBuffer = sizeof(rtt_buffer);
	up->RdOff = 0u;
	up->WrOff = 0u;
	up->Flags = SEGGER_RTT_MODE_BLOCK_IF_FIFO_FULL;
	for (i = 0; i < sizeof(rtt_buffer); i++)
	{
		rtt_buffer[i] = i;
	}
}


void main(void)
{
	int err;
	uint32_t p;

	printk("Entropy sample started[APP Core].\n");

	/*err = entropy_remote_init();
	if (err) {
		printk("Remote entropy driver initialization failed\n");
		return;
	}*/

	printk("Remote init send\n");

	initialize();
	while (1) {
		p = up->RdOff;
		up->WrOff = (p > 0) ? p - 1 : sizeof(rtt_buffer) - 1;
		//k_sleep(K_MSEC(1));
		__asm__ volatile ("nop\nnop\nnop\nnop\nnop\nnop\nnop\nnop\nnop\nnop\nnop\nnop\nnop\nnop\n");
	}

	while (true) {
		k_sleep(K_MSEC(2000));

		err = entropy_remote_get(buffer, sizeof(buffer));
		if (err) {
			printk("Entropy remote get failed: %d\n", err);
			continue;
		}

		for (int i = 0; i < BUFFER_LENGTH; i++) {
			printk("  0x%02x", buffer[i]);
		}

		printk("\n");

		k_sleep(K_MSEC(2000));

		err = entropy_remote_get_inline(buffer, sizeof(buffer));
		if (err) {
			printk("Entropy remote get failed: %d\n", err);
			continue;
		}

		for (int i = 0; i < BUFFER_LENGTH; i++) {
			printk("  0x%02x", buffer[i]);
		}

		printk("\n");

		k_sleep(K_MSEC(2000));

		err = entropy_remote_get_async(sizeof(buffer), result_callback);
		if (err) {
			printk("Entropy remote get async failed: %d\n", err);
			continue;
		}

		k_sleep(K_MSEC(2000));

		err = entropy_remote_get_cbk(sizeof(buffer), result_callback);
		if (err) {
			printk("Entropy remote get callback failed: %d\n", err);
			continue;
		}
	}
}
```

## src/entropy_ser.c
```c
/*
 * Copyright (c) 2020 Nordic Semiconductor ASA
 *
 * SPDX-License-Identifier: LicenseRef-BSD-5-Clause-Nordic
 */
#include <errno.h>
#include <init.h>

#include <tinycbor/cbor.h>

#include <nrf_rpc_cbor.h>

#include "../../common_ids.h"


#define CBOR_BUF_SIZE 16


struct entropy_get_result {
	u8_t *buffer;
	size_t length;
	int result;
};


static void (*result_callback)(int result, u8_t *buffer, size_t length);


NRF_RPC_GROUP_DEFINE(entropy_group, "nrf_sample_entropy", NULL, NULL, NULL);


void rsp_error_code_handle(CborValue *value, void *handler_data)
{
	CborError cbor_err;

	if (!cbor_value_is_integer(value)) {
		*(int *)handler_data = -EINVAL;
	}

	cbor_err = cbor_value_get_int(value, (int *)handler_data);
	if (cbor_err != CborNoError) {
		*(int *)handler_data = -EINVAL;
	}
}


int entropy_remote_init(void)
{
	int result;
	int err;
	struct nrf_rpc_cbor_ctx ctx;

	NRF_RPC_CBOR_ALLOC(ctx, CBOR_BUF_SIZE);

	err = nrf_rpc_cbor_cmd(&entropy_group, RPC_COMMAND_ENTROPY_INIT, &ctx,
			       rsp_error_code_handle, &result);
	if (err < 0) {
		return err;
	}

	return result;
}


static void entropy_get_rsp(CborValue *value, void *handler_data)
{
	size_t buflen;
	CborError cbor_err;
	struct entropy_get_result *result =
		(struct entropy_get_result *)handler_data;

	if (!cbor_value_is_integer(value)) {
		goto cbor_error_exit;
	}

	cbor_err = cbor_value_get_int(value, &result->result);
	if (cbor_err != CborNoError) {
		goto cbor_error_exit;
	}

	cbor_err = cbor_value_advance(value);
	if (cbor_err != CborNoError) {
		goto cbor_error_exit;
	}

	buflen = result->length;
	cbor_err = cbor_value_copy_byte_string(value, result->buffer, &buflen,
					       NULL);
	if (cbor_err != CborNoError || buflen != result->length) {
		goto cbor_error_exit;
	}

	return;

cbor_error_exit:
	result->result = -EINVAL;
}


int entropy_remote_get(u8_t *buffer, size_t length)
{
	int err;
	struct nrf_rpc_cbor_ctx ctx;
	struct entropy_get_result result = {
		.buffer = buffer,
		.length = length,
	};

	if (!buffer || length < 1) {
		return -EINVAL;
	}

	NRF_RPC_CBOR_ALLOC(ctx, CBOR_BUF_SIZE);

	cbor_encode_int(&ctx.encoder, length);

	err = nrf_rpc_cbor_cmd(&entropy_group, RPC_COMMAND_ENTROPY_GET, &ctx,
			       entropy_get_rsp, &result);
	if (err) {
		return -EINVAL;
	}

	return result.result;
}


int entropy_remote_get_inline(u8_t *buffer, size_t length)
{
	int err;
	CborError cbor_err;
	struct nrf_rpc_cbor_rsp_ctx ctx;
	int result;
	size_t buflen;

	if (!buffer || length < 1) {
		return -EINVAL;
	}

	NRF_RPC_CBOR_ALLOC(ctx, CBOR_BUF_SIZE);

	cbor_encode_int(&ctx.encoder, length);

	err = nrf_rpc_cbor_cmd_rsp(&entropy_group, RPC_COMMAND_ENTROPY_GET,
				   &ctx);
	if (err) {
		return -EINVAL;
	}

	if (!cbor_value_is_integer(&ctx.value)) {
		goto cbor_error_exit;
	}

	cbor_err = cbor_value_get_int(&ctx.value, &result);
	if (cbor_err != CborNoError) {
		goto cbor_error_exit;
	}

	cbor_err = cbor_value_advance(&ctx.value);
	if (cbor_err != CborNoError) {
		goto cbor_error_exit;
	}

	buflen = length;
	cbor_err = cbor_value_copy_byte_string(&ctx.value, buffer, &buflen,
					       NULL);
	if (cbor_err != CborNoError || buflen != length) {
		goto cbor_error_exit;
	}

	nrf_rpc_cbor_decoding_done(&ctx.value);
	return result;

cbor_error_exit:
	nrf_rpc_cbor_decoding_done(&ctx.value);
	return -EINVAL;
}


int entropy_remote_get_async(u16_t length, void (*callback)(int result,
							    u8_t *buffer,
							    size_t length))
{
	int err;
	struct nrf_rpc_cbor_ctx ctx;

	if (length < 1 || callback == NULL) {
		return -EINVAL;
	}

	result_callback = callback;

	NRF_RPC_CBOR_ALLOC(ctx, CBOR_BUF_SIZE);

	cbor_encode_int(&ctx.encoder, length);

	err = nrf_rpc_cbor_evt(&entropy_group, RPC_EVENT_ENTROPY_GET_ASYNC,
			       &ctx);
	if (err) {
		return -EINVAL;
	}

	return 0;
}


int entropy_remote_get_cbk(u16_t length, void (*callback)(int result,
							  u8_t *buffer,
							  size_t length))
{
	int err;
	int result;
	struct nrf_rpc_cbor_ctx ctx;

	if (length < 1 || callback == NULL) {
		return -EINVAL;
	}

	result_callback = callback;

	NRF_RPC_CBOR_ALLOC(ctx, CBOR_BUF_SIZE);

	cbor_encode_int(&ctx.encoder, length);

	err = nrf_rpc_cbor_cmd(&entropy_group, RPC_COMMAND_ENTROPY_GET_CBK,
			       &ctx, rsp_error_code_handle, &result);
	if (err) {
		return -EINVAL;
	}

	return result;
}


static void entropy_get_result_handler(CborValue *value, void *handler_data)
{
	bool is_command = (handler_data != NULL);
	int err_code;
	CborError err;
	size_t length;
	u8_t buf[32];

	if (result_callback == NULL) {
		nrf_rpc_cbor_decoding_done(value);
		return;
	}

	err = cbor_value_get_int(value, &err_code);
	if (err != CborNoError) {
		goto cbor_error_exit;
	}

	err = cbor_value_advance(value);
	if (err != CborNoError) {
		goto cbor_error_exit;
	}

	length = sizeof(buf);
	err = cbor_value_copy_byte_string(value, buf, &length, NULL);
	if (err != CborNoError) {
		goto cbor_error_exit;
	}

	nrf_rpc_cbor_decoding_done(value);

	result_callback(err_code, buf, length);

	if (is_command) {
		struct nrf_rpc_cbor_ctx ctx;

		NRF_RPC_CBOR_ALLOC(ctx, 0);
		nrf_rpc_cbor_rsp_no_err(&ctx);
	}

	return;

cbor_error_exit:
	nrf_rpc_cbor_decoding_done(value);
	result_callback(-EINVAL, buf, 0);
}


NRF_RPC_CBOR_CMD_DECODER(entropy_group, entropy_get_cbk_result,
			 RPC_COMMAND_ENTROPY_GET_CBK_RESULT,
			 entropy_get_result_handler, (void *)1);

NRF_RPC_CBOR_EVT_DECODER(entropy_group, entropy_get_async_result,
			 RPC_EVENT_ENTROPY_GET_ASYNC_RESULT,
			 entropy_get_result_handler, NULL);


static void err_handler(const struct nrf_rpc_err_report *report)
{
	printk("nRF RPC error %d ocurred. See nRF RPC logs for more details.",
	       report->code);
	k_oops();
}


static int serialization_init(struct device *dev)
{
	ARG_UNUSED(dev);

	int err;

	printk("Init begin\n");

	err = nrf_rpc_init(err_handler);
	if (err) {
		return -EINVAL;
	}

	printk("Init done\n");

	return 0;
}


SYS_INIT(serialization_init, POST_KERNEL, CONFIG_APPLICATION_INIT_PRIORITY);
```

## src/entropy_ser.h
```c
/*
 * Copyright (c) 2020 Nordic Semiconductor ASA
 *
 * SPDX-License-Identifier: Apache-2.0
 */

#ifndef ENTROPY_SER_H_
#define ENTROPY_SER_H_

#include <zephyr/types.h>

/**
 * @file
 * @defgroup entropy_ser Entropy driver serialization
 * @{
 * @brief Entropy serialization API.
 */

#ifdef __cplusplus
extern "C" {
#endif

/**@brief Function for initializing the remote Entropy driver instance.
 *
 * @retval 0 If the operation was successful.
 *           Otherwise, a (negative) error code is returned.
 */
int entropy_remote_init(void);

/**@brief Function for getting entropy value from the remote driver.
 *
 * This function demonstrates simples use of a command.
 *
 * @param[out] buffer Received entropy data.
 * @param[in] length Requested entropy length.
 *
 * @retval 0 If the operation was successful.
 *           Otherwise, a (negative) error code is returned.
 */
int entropy_remote_get(u8_t *buffer, size_t length);

/**@brief Function for getting entropy value from the remote driver.
 *
 * This function works identical as @ref entropy_remote_get, but also
 * demonstates how to encode parameters and decode results in the same function.
 *
 * @param[out] buffer Received entropy data.
 * @param[in] length Requested entropy length.
 *
 * @retval 0 If the operation was successful.
 *           Otherwise, a (negative) error code is returned.
 */
int entropy_remote_get_inline(u8_t *buffer, size_t length);

/**@brief Function for getting entropy value from the remote driver in an
 * asynchronous way.
 *
 * This function demonstates how to use events to accomplish asynchronous API
 * calls.
 *
 * @param[in] length Requested entropy length.
 * @param[in] callback Results will be passed to this callback.
 *
 * @retval 0 If the operation was successful.
 *           Otherwise, a (negative) error code is returned.
 */
int entropy_remote_get_async(size_t length, void (*callback)(int result,
							     u8_t *buffer,
							     size_t length));

/**@brief Function for getting entropy value in a callback from the remote
 * driver.
 *
 * This function executes synchronous callback to demonstrate reuse of
 * a thread that is waiting for a response.
 *
 * @param[in] length   Requested entropy length.
 * @param[in] callback Results will be passed to this callback.
 *
 * @retval 0 If the operation was successful.
 *           Otherwise, a (negative) error code is returned.
 */
int entropy_remote_get_cbk(u16_t length, void (*callback)(int result,
							  u8_t *buffer,
							  size_t length));
#ifdef __cplusplus
}
#endif

/**
 * @}
 */

#endif /* ENTROPY_SER_H_ */
```
