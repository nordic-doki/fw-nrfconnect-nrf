## CMakeLists.txt
```
#
# Copyright (c) 2020 Nordic Semiconductor
#
# SPDX-License-Identifier: LicenseRef-BSD-5-Clause-Nordic
#
cmake_minimum_required(VERSION 3.8)

set(NRF_SUPPORTED_BOARDS
  nrf5340pdk_nrf5340_cpunet
)

include(../../../../cmake/boilerplate.cmake)
include($ENV{ZEPHYR_BASE}/cmake/app/boilerplate.cmake NO_POLICY_SCOPE)
project(NONE)

# NORDIC SDK APP START
target_sources(app PRIVATE
  src/main.c
  src/entropy_ser.c
)
# NORDIC SDK APP END
```

## sample.yaml
```
sample:
  name: Entropy remote network core
  description: Entropy remote network core sample
tests:
  test_build:
    build_only: true
    build_on_all: true
    platform_whitelist: nrf5340pdk_nrf5340_cpunet
```

## prj.conf
```kconfig
CONFIG_IPM=y
CONFIG_IPM_NRFX=y
CONFIG_IPM_MSG_CH_1_ENABLE=y
CONFIG_IPM_MSG_CH_1_RX=y
CONFIG_IPM_MSG_CH_0_ENABLE=y
CONFIG_IPM_MSG_CH_0_TX=y

CONFIG_HEAP_MEM_POOL_SIZE=4096

CONFIG_OPENAMP=y
CONFIG_TINYCBOR=y
CONFIG_RPMSG_MASTER=n
CONFIG_THREAD_CUSTOM_DATA=y
CONFIG_ENTROPY_GENERATOR=y

CONFIG_NRF_RPC=y
CONFIG_NRF_RPC_CBOR=y
CONFIG_NRF_RPC_THREAD_STACK_SIZE=4096

CONFIG_LOG=y
CONFIG_NRF_RPC_LOG_LEVEL_INF=y
CONFIG_NRF_RPC_TR_LOG_LEVEL_INF=y
CONFIG_NRF_RPC_OS_LOG_LEVEL_INF=y

# Uncommend to allow better debugging
#CONFIG_NO_OPTIMIZATIONS=y
#CONFIG_DEBUG=y

CONFIG_USE_SEGGER_RTT=y
CONFIG_RTT_CONSOLE=y
```

## src/main.c
```c
/*
 * Copyright (c) 2020 Nordic Semiconductor ASA
 *
 * SPDX-License-Identifier: LicenseRef-BSD-5-Clause-Nordic
 */

#include <zephyr.h>

#if 1
#include <SEGGER_RTT.h>
uint8_t rtt_buffer[8192];
static SEGGER_RTT_BUFFER_UP *up;
static void initialize(void)
{
	int i;

	up = &_SEGGER_RTT.aUp[1];
	up->sName = "test_rtt";
	up->pBuffer = (char *)(&rtt_buffer[0]);
	up->SizeOfBuffer = sizeof(rtt_buffer);
	//up->RdOff = 0u;
	//up->WrOff = 0u;
	up->Flags = SEGGER_RTT_MODE_BLOCK_IF_FIFO_FULL;
	for (i = 0; i < sizeof(rtt_buffer); i++)
	{
		rtt_buffer[i] = i;
	}
}
#endif

void main(void)
{
	/* The only activity of this application is interaction with the APP
	 * core using serialized communication through the nRF RPC library.
	 * The necessary handlers are registered through nRF RPC interface
	 * and start at system boot.
	 */
	printk("Entropy sample started[NET Core].\n");
	uint32_t p;

	printk("Remote init send\n");

	initialize();
	while (1) {
		p = up->RdOff;
		up->WrOff = (p > 0) ? p - 1 : sizeof(rtt_buffer) - 1;
		__asm__ volatile ("nop\nnop\nnop\nnop\nnop\nnop\nnop\nnop\nnop\nnop\nnop\nnop\nnop\nnop\n");
	}

}
```

## src/entropy_ser.c
```c
/*
 * Copyright (c) 2020 Nordic Semiconductor ASA
 *
 * SPDX-License-Identifier: LicenseRef-BSD-5-Clause-Nordic
 */
#include <errno.h>
#include <init.h>
#include <drivers/entropy.h>

#include <tinycbor/cbor.h>
#include <nrf_rpc_cbor.h>

#include <device.h>

#include "../../common_ids.h"


#define CBOR_BUF_SIZE 16

enum call_type {
	CALL_TYPE_STANDARD,
	CALL_TYPE_CBK,
	CALL_TYPE_ASYNC,
};

NRF_RPC_GROUP_DEFINE(entropy_group, "nrf_sample_entropy", NULL, NULL, NULL);

static struct device *entropy;

static void rsp_error_code_send(int err_code)
{
	struct nrf_rpc_cbor_ctx ctx;

	NRF_RPC_CBOR_ALLOC(ctx, CBOR_BUF_SIZE);

	cbor_encode_int(&ctx.encoder, err_code);

	nrf_rpc_cbor_rsp_no_err(&ctx);
}

static void entropy_init_handler(CborValue *packet, void *handler_data)
{
	nrf_rpc_cbor_decoding_done(packet);

	entropy = device_get_binding(DT_CHOSEN_ZEPHYR_ENTROPY_LABEL);
	if (!entropy) {
		rsp_error_code_send(-EINVAL);
		return;
	}

	rsp_error_code_send(0);
}


NRF_RPC_CBOR_CMD_DECODER(entropy_group, entropy_init, RPC_COMMAND_ENTROPY_INIT,
			 entropy_init_handler, NULL);


static void entropy_get_rsp(int err_code, const u8_t *data, size_t length)
{
	struct nrf_rpc_cbor_ctx ctx;

	NRF_RPC_CBOR_ALLOC(ctx, CBOR_BUF_SIZE + length);

	cbor_encode_int(&ctx.encoder, err_code);
	cbor_encode_byte_string(&ctx.encoder, data, length);

	nrf_rpc_cbor_rsp_no_err(&ctx);
}

static void rsp_empty_handler(CborValue *value, void *handler_data)
{
}

static void entropy_get_result(int err_code, const u8_t *data, size_t length,
			       enum call_type type)
{
	struct nrf_rpc_cbor_ctx ctx;

	NRF_RPC_CBOR_ALLOC(ctx, CBOR_BUF_SIZE + length);

	cbor_encode_int(&ctx.encoder, err_code);
	cbor_encode_byte_string(&ctx.encoder, data, length);

	if (type == CALL_TYPE_ASYNC) {
		nrf_rpc_cbor_evt_no_err(&entropy_group,
					RPC_EVENT_ENTROPY_GET_ASYNC_RESULT,
					&ctx);
	} else {
		nrf_rpc_cbor_cmd_no_err(&entropy_group,
					RPC_COMMAND_ENTROPY_GET_CBK_RESULT,
					&ctx, rsp_empty_handler, NULL);
	}
}

static void entropy_get_handler(CborValue *packet, void *handler_data)
{
	CborError cbor_err;
	int err;
	int length;
	u8_t *buf;
	enum call_type type = (enum call_type)handler_data;

	cbor_err = cbor_value_get_int(packet, &length);

	nrf_rpc_cbor_decoding_done(packet);

	if (cbor_err != CborNoError || length < 0 || length > 0xFFFF) {
		err = -EBADMSG;
		goto error_exit;
	}

	buf = k_malloc(length);
	if (!buf) {
		err = -ENOMEM;
		goto error_exit;
	}

	err = entropy_get_entropy(entropy, buf, length);

	switch (type) {
	case CALL_TYPE_STANDARD:
		entropy_get_rsp(err, buf, length);
		break;

	case CALL_TYPE_CBK:
		entropy_get_result(err, buf, length, type);
		rsp_error_code_send(err);
		break;

	case CALL_TYPE_ASYNC:
		entropy_get_result(err, buf, length, type);
		break;
	}

	k_free(buf);

	return;

error_exit:
	switch (type) {
	case CALL_TYPE_STANDARD:
		entropy_get_rsp(err, "", 0);
		break;

	case CALL_TYPE_CBK:
		rsp_error_code_send(err);
		break;

	case CALL_TYPE_ASYNC:
		entropy_get_result(err, "", 0, type);
		break;
	}
}


NRF_RPC_CBOR_CMD_DECODER(entropy_group, entropy_get,
			 RPC_COMMAND_ENTROPY_GET, entropy_get_handler,
			 (void *)CALL_TYPE_STANDARD);

NRF_RPC_CBOR_CMD_DECODER(entropy_group, entropy_get_cbk,
			 RPC_COMMAND_ENTROPY_GET_CBK, entropy_get_handler,
			 (void *)CALL_TYPE_CBK);

NRF_RPC_CBOR_EVT_DECODER(entropy_group, entropy_get_async,
			 RPC_EVENT_ENTROPY_GET_ASYNC, entropy_get_handler,
			 (void *)CALL_TYPE_ASYNC);


static void err_handler(const struct nrf_rpc_err_report *report)
{
	printk("nRF RPC error %d ocurred. See nRF RPC logs for more details.",
	       report->code);
	k_oops();
}


static int serialization_init(struct device *dev)
{
	ARG_UNUSED(dev);

	int err;

	printk("Init begin\n");

	err = nrf_rpc_init(err_handler);
	if (err) {
		return -EINVAL;
	}

	printk("Init done\n");

	return 0;
}


SYS_INIT(serialization_init, POST_KERNEL, CONFIG_APPLICATION_INIT_PRIORITY);
```
