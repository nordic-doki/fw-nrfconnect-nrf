## CMakeLists.txt
```
#
# Copyright (c) 2020 Nordic Semiconductor
#
# SPDX-License-Identifier: LicenseRef-BSD-5-Clause-Nordic
#
cmake_minimum_required(VERSION 3.8)


set(NRF_SUPPORTED_BOARDS
  nrf5340_dk_nrf5340_cpunet
)

include(../../../../cmake/boilerplate.cmake)
include($ENV{ZEPHYR_BASE}/cmake/app/boilerplate.cmake NO_POLICY_SCOPE)
project(NONE)

# NORDIC SDK APP START
target_sources(app PRIVATE
  src/main.c
  src/serialization.c
)

# NORDIC SDK APP END

target_link_libraries(app PRIVATE TINYCBOR)
zephyr_library_include_directories(.)
zephyr_library_include_directories(../common)
```

## Kconfig
```
#
# Copyright (c) 2020 Nordic Semiconductor
#
# SPDX-License-Identifier: LicenseRef-BSD-5-Clause-Nordic
#

source "Kconfig.zephyr"

menu "Nordic UART BLE GATT service application core sample"

config BT_GATT_NUS_SECURITY_ENABLED
	bool "Enable security"
	default y
	select BT_SMP
	help
	  "Enable BLE security for the UART service"

endmenu
```

## prj.conf
```kconfig
#
# Copyright (c) 2020 Nordic Semiconductor
#
# SPDX-License-Identifier: LicenseRef-BSD-5-Clause-Nordic
#
CONFIG_NCS_SAMPLES_DEFAULTS=y

CONFIG_BT=y
CONFIG_BT_PERIPHERAL=y
CONFIG_BT_DEVICE_NAME="Nordic_UART_Service"
CONFIG_BT_DEVICE_APPEARANCE=833
CONFIG_BT_MAX_CONN=1
CONFIG_BT_MAX_PAIRED=1

# Enable the NUS service
CONFIG_BT_GATT_NUS=y

# Enable bonding
CONFIG_BT_SETTINGS=y
CONFIG_FLASH=y
CONFIG_FLASH_PAGE_LAYOUT=y
CONFIG_FLASH_MAP=y
CONFIG_NVS=y
CONFIG_SETTINGS=y

# This example requires more workqueue stack
CONFIG_SYSTEM_WORKQUEUE_STACK_SIZE=2048

CONFIG_HEAP_MEM_POOL_SIZE=4096

CONFIG_ASSERT=n

CONFIG_IPM=y
CONFIG_IPM_NRFX=y

CONFIG_IPM_MSG_CH_1_ENABLE=y
CONFIG_IPM_MSG_CH_1_RX=y
CONFIG_IPM_MSG_CH_0_ENABLE=y
CONFIG_IPM_MSG_CH_0_TX=y

CONFIG_OPENAMP=y
CONFIG_TINYCBOR=y

CONFIG_NRF_RPC=y
CONFIG_NRF_RPC_CBOR=y
CONFIG_RPMSG_REMOTE=y
CONFIG_THREAD_CUSTOM_DATA=y
```

## src/main.c
```c
/*
 * Copyright (c) 2020 Nordic Semiconductor ASA
 *
 * SPDX-License-Identifier: LicenseRef-BSD-5-Clause-Nordic
 */

/** @file
 *  @brief Nordic UART Bridge Service (NUS) sample
 */

#include <zephyr/types.h>
#include <zephyr.h>

#include <bluetooth/bluetooth.h>
#include <bluetooth/uuid.h>
#include <bluetooth/gatt.h>
#include <bluetooth/hci.h>

#include <bluetooth/services/nus.h>
#include <settings/settings.h>

#include <stdio.h>

#include "serialization.h"

#define DEVICE_NAME CONFIG_BT_DEVICE_NAME
#define DEVICE_NAME_LEN (sizeof(DEVICE_NAME) - 1)

static struct bt_conn *current_conn;

static const struct bt_data ad[] = {
	BT_DATA_BYTES(BT_DATA_FLAGS, (BT_LE_AD_GENERAL | BT_LE_AD_NO_BREDR)),
	BT_DATA(BT_DATA_NAME_COMPLETE, DEVICE_NAME, DEVICE_NAME_LEN),
};

static const struct bt_data sd[] = {
	BT_DATA_BYTES(BT_DATA_UUID128_ALL, NUS_UUID_SERVICE),
};

static void connected(struct bt_conn *conn, u8_t err)
{
	char addr[BT_ADDR_LE_STR_LEN];

	if (err) {
		printk("Connection failed (err %u)\n", err);
		return;
	}

	err = bt_nus_connection_evt_send(bt_conn_get_dst(conn), err);
	if (err) {
		printk("Connection event send failed (err %d)\n", err);
		return;
	}

	bt_addr_le_to_str(bt_conn_get_dst(conn), addr, sizeof(addr));
	printk("Connected %s\n", addr);

	current_conn = bt_conn_ref(conn);
}

static void disconnected(struct bt_conn *conn, u8_t reason)
{
	int err;
	char addr[BT_ADDR_LE_STR_LEN];

	bt_addr_le_to_str(bt_conn_get_dst(conn), addr, sizeof(addr));

	printk("Disconnected: %s (reason %u)\n", addr, reason);

	if (current_conn) {
		bt_conn_unref(current_conn);
		current_conn = NULL;
	}

	err = bt_nus_disconnection_evt_send(bt_conn_get_dst(conn), reason);
	if (err) {
		printk("disconnection event send failedi (err %d)\n", err);
	}
}

#ifdef CONFIG_BT_GATT_NUS_SECURITY_ENABLED
static void security_changed(struct bt_conn *conn, bt_security_t level,
			     enum bt_security_err err)
{
	char addr[BT_ADDR_LE_STR_LEN];

	bt_addr_le_to_str(bt_conn_get_dst(conn), addr, sizeof(addr));

	if (!err) {
		printk("Security changed: %s level %u\n", addr, level);
	} else {
		printk("Security failed: %s level %u err %d\n", addr, level,
			err);
	}
}
#endif

static struct bt_conn_cb conn_callbacks = {
	.connected    = connected,
	.disconnected = disconnected,
#ifdef CONFIG_BT_GATT_NUS_SECURITY_ENABLED
	.security_changed = security_changed,
#endif
};

#if defined(CONFIG_BT_GATT_NUS_SECURITY_ENABLED)
static void auth_cancel(struct bt_conn *conn)
{
	char addr[BT_ADDR_LE_STR_LEN];

	bt_addr_le_to_str(bt_conn_get_dst(conn), addr, sizeof(addr));

	printk("Pairing cancelled: %s\n", addr);
}

static void pairing_confirm(struct bt_conn *conn)
{
	char addr[BT_ADDR_LE_STR_LEN];

	bt_addr_le_to_str(bt_conn_get_dst(conn), addr, sizeof(addr));

	bt_conn_auth_pairing_confirm(conn);

	printk("Pairing confirmed: %s\n", addr);
}

static void pairing_complete(struct bt_conn *conn, bool bonded)
{
	char addr[BT_ADDR_LE_STR_LEN];

	bt_addr_le_to_str(bt_conn_get_dst(conn), addr, sizeof(addr));

	printk("Pairing completed: %s, bonded: %d\n", addr, bonded);
}

static void pairing_failed(struct bt_conn *conn, enum bt_security_err reason)
{
	char addr[BT_ADDR_LE_STR_LEN];

	bt_addr_le_to_str(bt_conn_get_dst(conn), addr, sizeof(addr));

	printk("Pairing failed conn: %s, reason %d\n", addr, reason);
}

static struct bt_conn_auth_cb conn_auth_callbacks = {
	.cancel = auth_cancel,
	.pairing_confirm = pairing_confirm,
	.pairing_complete = pairing_complete,
	.pairing_failed = pairing_failed
};
#else
static struct bt_conn_auth_cb conn_auth_callbacks;
#endif

static void bt_receive_cb(struct bt_conn *conn, const u8_t *const data,
			  u16_t len)
{
	int err;
	char addr[BT_ADDR_LE_STR_LEN] = {0};

	bt_addr_le_to_str(bt_conn_get_dst(conn), addr, ARRAY_SIZE(addr));

	printk("Received data from: %s\n", addr);

	err = bt_nus_received_evt_send(bt_conn_get_dst(conn), data, len);
	if (err) {
		printk("BT received event send failed (err %d)\n", err);
	}
}

static struct bt_gatt_nus_cb nus_cb = {
	.received_cb = bt_receive_cb,
};

void bt_ready(int err)
{
	printk("Bluetooth initialized\n");

	if (IS_ENABLED(CONFIG_SETTINGS)) {
		settings_load();
	}

	err = bt_gatt_nus_init(&nus_cb);
	if (err) {
		printk("Failed to initialize UART service (err: %d)\n", err);
		return;
	}

	err = bt_le_adv_start(BT_LE_ADV_CONN, ad, ARRAY_SIZE(ad), sd,
			      ARRAY_SIZE(sd));
	if (err) {
		printk("Advertising failed to start (err %d)\n", err);
	}
}

void main(void)
{
	printk("Starting Nordic UART service example[NET CORE]\n");

	bt_conn_cb_register(&conn_callbacks);

	if (IS_ENABLED(CONFIG_BT_GATT_NUS_SECURITY_ENABLED)) {
		bt_conn_auth_cb_register(&conn_auth_callbacks);
	}
}
```

## src/serialization.c
```c
#include <bluetooth/services/nus.h>

#include <nrf_rpc_cbor.h>

#include <init.h>
#include <logging/log.h>

LOG_MODULE_REGISTER(serialization);

#include "serialization.h"
#include "../../ser_common.h"

#define CBOR_BUF_SIZE 32

#define BT_NUS_MAX_DATA_SIZE 20

NRF_RPC_GROUP_DEFINE(entropy_group, NRF_RPC_USER_GROUP_ID_FIRST);

__weak void bt_ready(int err)
{
	LOG_INF("Bluetooth initialized, err %d.", err);
}

static int rsp_error_code_sent(int err_code)
{
	int err;
	CborEncoder *encoder;
	struct nrf_rpc_cbor_rsp_ctx ctx;

	NRF_RPC_CBOR_RSP_ALLOC(ctx, encoder, CBOR_BUF_SIZE, return -ENOMEM);

	if (cbor_encode_int(encoder, err_code) != CborNoError) {
		return -EINVAL;
	}

	err = nrf_rpc_cbor_rsp_send(&ctx);
	if (err) {
		return -EINVAL;
	}

	return 0;
}

static int bt_cmd_bt_nus_init(CborValue *packet, void* handler_data)
{
	int err;

	nrf_rpc_decoding_done();

	err = bt_enable(bt_ready);
	if (err) {
		LOG_ERR("Failed to enable Bluetooth.");
	}

	return rsp_error_code_sent(err);
}

static int bt_cmd_gatt_nus_exec(CborValue *packet, void* handler_data)
{
	int err;
	CborError cbor_err;
	u8_t buf[BT_NUS_MAX_DATA_SIZE];
	size_t len = sizeof(buf);

	cbor_err = cbor_value_copy_byte_string(packet, buf, &len, packet);
	if (cbor_err) {
		return NRF_RPC_ERR_INTERNAL;
	}

	nrf_rpc_decoding_done();

	err = bt_gatt_nus_send(NULL, buf, len);

	return rsp_error_code_sent(err);
}

static int ble_event_send(const bt_addr_le_t *addr, u8_t evt,
			  const u8_t *data, size_t length)
{
	int err;
	CborEncoder *encoder;
	struct nrf_rpc_cbor_evt_ctx ctx;

	NRF_RPC_CBOR_EVT_ALLOC(ctx, &entropy_group, encoder, CBOR_BUF_SIZE, return -ENOMEM);

	if (cbor_encode_simple_value(encoder, addr->type) !=
	    CborNoError) {
		return -EINVAL;
	}

	if (cbor_encode_byte_string(encoder,
				    addr->a.val,
				    sizeof(addr->a.val)) !=
	     CborNoError) {
		return -EINVAL;
	}

	if (cbor_encode_byte_string(encoder, data, length) !=
	    CborNoError) {
		return -EINVAL;
	}

	err = nrf_rpc_cbor_evt_send(&ctx, evt);
	if (err) {
		return -EINVAL;
	}

	return 0;
}

int bt_nus_connection_evt_send(const bt_addr_le_t *addr, u8_t error)
{
	if (!addr) {
		return -EINVAL;
	}

	return ble_event_send(addr, SER_EVT_CONNECTED, &error, sizeof(error));
}

int bt_nus_disconnection_evt_send(const bt_addr_le_t *addr, u8_t reason)
{
	if (!addr) {
		return -EINVAL;
	}

	return ble_event_send(addr, SER_EVT_DISCONNECTED, &reason,
			      sizeof(reason));
}

int bt_nus_received_evt_send(const bt_addr_le_t *addr, const u8_t *data,
			     size_t length)
{
	if (!addr || !data) {
		return -EINVAL;
	}

	if (length < 1) {
		return -EINVAL;
	}

	return ble_event_send(addr, SER_EVT_NUS_RECEIVED, data, length);
}

static int serialization_init(struct device *dev)
{
	ARG_UNUSED(dev);

	int err;

	printk("Init begin\n");

	err = nrf_rpc_init();
	if (err) {
		return -EINVAL;
	}

	printk("Init done\n");

	return 0;
}

NRF_RPC_CBOR_CMD_DECODER(entropy_group, nus_init, SER_COMMAND_NUS_INIT,
			 bt_cmd_bt_nus_init, NULL);
NRF_RPC_CBOR_CMD_DECODER(entropy_group, nus_send, SER_COMMAND_NUS_SEND,
			 bt_cmd_gatt_nus_exec, NULL);

SYS_INIT(serialization_init, POST_KERNEL, CONFIG_APPLICATION_INIT_PRIORITY);
```

## src/serialization.h
```c
/*
 * Copyright (c) 2020 Nordic Semiconductor ASA
 *
 * SPDX-License-Identifier: Apache-2.0
 */

#ifndef SERIALIZATION_H_
#define SERIALIZATION_H_

#include <errno.h>
#include <cbor.h>
#include <bluetooth/addr.h>

/**
 * @file
 * @defgroup bt_serialization BLE Nordic UART Service serialization
 * @{
 * @brief BLE Nordic UART(NUS) serialization API.
 */

#ifdef __cplusplus
extern "C" {
#endif

/**@brief Notify an Application core about a new connection.
 *
 * @param[in] addr Address of connected device.
 * @param[in] err HCI error. Zero for success, non-zero otherwise.
 *
 * @retval 0 If the operation was successful.
 *           Otherwise, a (negative) error code is returned.
 */
int bt_nus_connection_evt_send(const bt_addr_le_t *addr, u8_t error);

/**@brief Notify an Application core that a connection
 *        has been disconnected.
 *
 * @param[in] addr Address of connected device.
 * @param[in] err HCI error. Zero for success, non-zero otherwise.
 *
 * @retval 0 If the operation was successful.
 *           Otherwise, a (negative) error code is returned.
 */
int bt_nus_disconnection_evt_send(const bt_addr_le_t *addr, u8_t reason);

/**@brief Notify an Application core that the NUS service
 *        received new data.
 *
 * @param[in] addr Device address which sent data.
 * @param[in] data Received data.
 * @param[in] length Data length.
 *
 * @retval 0 If the operation was successful.
 *           Otherwise, a (negative) error code is returned.
 */
int bt_nus_received_evt_send(const bt_addr_le_t *addr,
			     const u8_t *data, size_t length);

#ifdef __cplusplus
}
#endif



/**
 *@}
 */

#endif /* SERIALIZATION_H_ */
```
