## CMakeLists.txt
```
#
# Copyright (c) 2020 Nordic Semiconductor
#
# SPDX-License-Identifier: LicenseRef-BSD-5-Clause-Nordic
#
cmake_minimum_required(VERSION 3.8)

set(NRF_SUPPORTED_BOARDS
  nrf5340_dk_nrf5340_cpuapp
  nrf5340_dk_nrf5340_cpuappns
)

include(../../../../cmake/boilerplate.cmake)
include($ENV{ZEPHYR_BASE}/cmake/app/boilerplate.cmake NO_POLICY_SCOPE)
project(NONE)

# NORDIC SDK APP START
target_sources(app PRIVATE
  src/main.c
  src/serialization.c
)

# NORDIC SDK APP END

target_link_libraries(app PRIVATE TINYCBOR)
```

## Kconfig
```
#
# Copyright (c) 2020 Nordic Semiconductor
#
# SPDX-License-Identifier: LicenseRef-BSD-5-Clause-Nordic
#

source "Kconfig.zephyr"

menu "Nordic UART BLE GATT service application core sample"

config BT_GATT_NUS_THREAD_STACK_SIZE
	int "Thread stack size"
	default 1024
	help
	  Stack size used in each of the two threads

config BT_GATT_NUS_UART_BUFFER_SIZE
	int "UART payload buffer element size"
	default 20
	help
	  Size of the payload buffer in each RX and TX FIFO element

endmenu
```

## prj.conf
```kconfig
#
# Copyright (c) 2020 Nordic Semiconductor
#
# SPDX-License-Identifier: LicenseRef-BSD-5-Clause-Nordic
#
CONFIG_NCS_SAMPLES_DEFAULTS=y

CONFIG_UART_INTERRUPT_DRIVEN=y
CONFIG_SERIAL=y
CONFIG_GPIO=y

# Make sure printk is not printing to the UART console
CONFIG_CONSOLE=y
CONFIG_UART_CONSOLE=y

CONFIG_HEAP_MEM_POOL_SIZE=4096

CONFIG_IPM=y
CONFIG_IPM_NRFX=y
CONFIG_IPM_MSG_CH_1_ENABLE=y
CONFIG_IPM_MSG_CH_1_TX=y
CONFIG_IPM_MSG_CH_0_ENABLE=y
CONFIG_IPM_MSG_CH_0_RX=y

CONFIG_OPENAMP=y
CONFIG_TINYCBOR=y

# Enable DK LED and Buttons library
CONFIG_DK_LIBRARY=y

# This example requires more workqueue stack
CONFIG_SYSTEM_WORKQUEUE_STACK_SIZE=2048

CONFIG_NRF_RPC=y
CONFIG_NRF_RPC_CBOR=y
CONFIG_RPMSG_MASTER=y
CONFIG_THREAD_CUSTOM_DATA=y
```

## src/main.c
```c
/*
 * Copyright (c) 2020 Nordic Semiconductor ASA
 *
 * SPDX-License-Identifier: LicenseRef-BSD-5-Clause-Nordic
 */

/** @file
 *  @brief Nordic UART Bridge Service (NUS) sample
 */

#include <drivers/uart.h>
#include <zephyr/types.h>
#include <zephyr.h>

#include <device.h>
#include <soc.h>

#include <dk_buttons_and_leds.h>

#include <stdio.h>
#include <string.h>
#include <init.h>

#include "serialization.h"

#define STACKSIZE CONFIG_BT_GATT_NUS_THREAD_STACK_SIZE
#define PRIORITY 7

#define RUN_STATUS_LED DK_LED1
#define RUN_LED_BLINK_INTERVAL 1000

#define CON_STATUS_LED DK_LED2

#define UART_BUF_SIZE CONFIG_BT_GATT_NUS_UART_BUFFER_SIZE

#define BT_ADDR_LE_STR_LEN 30

static K_SEM_DEFINE(ble_init_ok, 0, 2);

static struct device *uart;

struct uart_data_t {
	void *fifo_reserved;
	u8_t data[UART_BUF_SIZE];
	u16_t len;
};

static K_FIFO_DEFINE(fifo_uart_tx_data);
static K_FIFO_DEFINE(fifo_uart_rx_data);

static int bt_addr_le_to_str(const bt_addr_le_t *addr, char *str,
			     size_t len)
{
	char type[10];

	switch (addr->type) {
	case BT_ADDR_LE_PUBLIC:
		strcpy(type, "public");
		break;
	case BT_ADDR_LE_RANDOM:
		strcpy(type, "random");
		break;
	case BT_ADDR_LE_PUBLIC_ID:
		strcpy(type, "public-id");
		break;
	case BT_ADDR_LE_RANDOM_ID:
		strcpy(type, "random-id");
		break;
	default:
		snprintk(type, sizeof(type), "0x%02x", addr->type);
		break;
	}

	return snprintk(str, len, "%02X:%02X:%02X:%02X:%02X:%02X (%s)",
			addr->a.val[5], addr->a.val[4], addr->a.val[3],
			addr->a.val[2], addr->a.val[1], addr->a.val[0], type);
}

static void uart_cb(struct device *uart)
{
	static struct uart_data_t *rx;

	uart_irq_update(uart);

	if (uart_irq_rx_ready(uart)) {
		int data_length;

		if (!rx) {
			rx = k_malloc(sizeof(*rx));
			if (rx) {
				rx->len = 0;
			} else {
				char dummy;

				printk("Not able to allocate UART receive buffer\n");

				/* Drop one byte to avoid spinning in a
				 * eternal loop.
				 */
				uart_fifo_read(uart, &dummy, 1);

				return;
			}
		}

		data_length = uart_fifo_read(uart, &rx->data[rx->len],
		UART_BUF_SIZE - rx->len);
		rx->len += data_length;

		if (rx->len > 0) {
			/* Send buffer to bluetooth unit if either buffer size
			 * is reached or the char \n or \r is received, which
			 * ever comes first
			 */
			if ((rx->len == UART_BUF_SIZE) ||
			    (rx->data[rx->len - 1] == '\n') ||
			    (rx->data[rx->len - 1] == '\r')) {
				k_fifo_put(&fifo_uart_rx_data, rx);
				rx = NULL;
			}
		}
	}

	if (uart_irq_tx_ready(uart)) {
		struct uart_data_t *buf = k_fifo_get(&fifo_uart_tx_data,
						     K_NO_WAIT);
		u16_t written = 0;

		/* Nothing in the FIFO, nothing to send */
		if (!buf) {
			uart_irq_tx_disable(uart);
			return;
		}

		while (buf->len > written) {
			written += uart_fifo_fill(uart, &buf->data[written],
					buf->len - written);
		}

		while (!uart_irq_tx_complete(uart)) {
			/* Wait for the last byte to get
			 * shifted out of the module
			 */
		}

		if (k_fifo_is_empty(&fifo_uart_tx_data)) {
			uart_irq_tx_disable(uart);
		}

		k_free(buf);
	}
}

static int uart_init(void)
{
	uart = device_get_binding("UART_0");
	if (!uart) {
		return -ENXIO;
	}

	uart_irq_callback_set(uart, uart_cb);
	uart_irq_rx_enable(uart);

	return 0;
}

static void bt_connected(const bt_addr_le_t *addr, u8_t err)
{
	char addr_str[BT_ADDR_LE_STR_LEN];

	if (err) {
		printk("Connection failed (err %u)\n", err);
		return;
	}

	bt_addr_le_to_str(addr, addr_str, sizeof(addr_str));

	printk("Connected %s\n", addr_str);

	dk_set_led_on(CON_STATUS_LED);
}

static void bt_disconnected(const bt_addr_le_t *addr, u8_t reason)
{
	char addr_str[BT_ADDR_LE_STR_LEN];

	bt_addr_le_to_str(addr, addr_str, sizeof(addr_str));

	printk("Disconnected: %s (reason %u)\n", addr_str, reason);

	dk_set_led_off(CON_STATUS_LED);
}

static void bt_received(const bt_addr_le_t *addr, const u8_t *data, size_t len)
{
	char addr_str[BT_ADDR_LE_STR_LEN] = { 0 };

	bt_addr_le_to_str(addr, addr_str, ARRAY_SIZE(addr_str));

	printk("Received data from: %s\n", addr_str);

	for (u16_t pos = 0; pos != len;) {
		struct uart_data_t *tx = k_malloc(sizeof(*tx));

		if (!tx) {
			printk("Not able to allocate UART send data buffer\n");
			return;
		}

		/* Keep the last byte of TX buffer for potential LF char. */
		size_t tx_data_size = sizeof(tx->data) - 1;

		if ((len - pos) > tx_data_size) {
			tx->len = tx_data_size;
		} else {
			tx->len = (len - pos);
		}

		memcpy(tx->data, &data[pos], tx->len);

		pos += tx->len;

		/* Append the LF character when the CR character triggered
		 * transmission from the peer.
		 */
		if ((pos == len) && (data[len - 1] == '\r')) {
			tx->data[tx->len] = '\n';
			tx->len++;
		}

		k_fifo_put(&fifo_uart_tx_data, tx);
	}

	/* Start the UART transfer by enabling the TX ready interrupt */
	uart_irq_tx_enable(uart);
}

static const struct bt_nus_cb bt_nus_callbacks = {
	.bt_connected    = bt_connected,
	.bt_disconnected = bt_disconnected,
	.bt_received = bt_received,
};

void error(void)
{
	dk_set_leds_state(DK_ALL_LEDS_MSK, DK_NO_LEDS_MSK);

	while (true) {
		/* Spin for ever */
		k_sleep(1000);
	}
}

static void configure_gpio(void)
{
	int err;

	err = dk_leds_init();
	if (err) {
		printk("Cannot init LEDs (err: %d)\n", err);
	}
}

static void led_blink_thread(void)
{
	int blink_status = 0;
	int err = 0;

	err = uart_init();
	if (err) {
		error();
	}

	configure_gpio();

	bt_nus_callback_register(&bt_nus_callbacks);

	err = bt_nus_init();
	if (err < 0) {
		printk("NUS service initialization failed: %d\n", err);
		error();
	}

	k_sem_give(&ble_init_ok);

	printk("Starting Nordic UART service example[APP CORE]\n");

	for (;;) {
		dk_set_led(RUN_STATUS_LED, (++blink_status) % 2);
		k_sleep(RUN_LED_BLINK_INTERVAL);
	}
}

void ble_write_thread(void)
{
	int err = 0;
	/* Don't go any further until BLE is initailized */
	k_sem_take(&ble_init_ok, K_FOREVER);

	for (;;) {
		/* Wait indefinitely for data to be sent over bluetooth */
		struct uart_data_t *buf = k_fifo_get(&fifo_uart_rx_data,
						     K_FOREVER);

		err = bt_nus_transmit(buf->data, buf->len);
		printk("NUS send %d bytes status %d\n", buf->len, err);

		k_free(buf);
	}
}

K_THREAD_DEFINE(led_blink_thread_id, STACKSIZE, led_blink_thread, NULL, NULL,
		NULL, PRIORITY, 0, K_NO_WAIT);

K_THREAD_DEFINE(ble_write_thread_id, STACKSIZE, ble_write_thread, NULL, NULL,
		NULL, PRIORITY, 0, K_NO_WAIT);
```

## src/serialization.c
```c
#include <cbor.h>
#include <errno.h>
#include <init.h>
#include <logging/log.h>

LOG_MODULE_REGISTER(serialization);

#include <nrf_rpc_cbor.h>

#include "serialization.h"
#include "../../ser_common.h"

#define CBOR_BUF_SIZE 32

#define BT_ADDR_SIZE 6
#define BT_NUS_MAX_DATA_SIZE 20

NRF_RPC_GROUP_DEFINE(entropy_group, NRF_RPC_USER_GROUP_ID_FIRST);

static const struct bt_nus_cb *bt_cb;

int rsp_error_code_handle(CborValue *parser, void *hander_data)
{
	CborError err;

	if (!cbor_value_is_integer(parser)) {
		*(int *)hander_data = -EINVAL;
		return NRF_RPC_SUCCESS;
	}

	err = cbor_value_get_int(parser, (int *)hander_data);
	if (err != CborNoError) {
		*(int *)hander_data = -EINVAL;
		return NRF_RPC_SUCCESS;
	}

	return NRF_RPC_SUCCESS;
}

static void connected_evt(const bt_addr_le_t *addr, u8_t err)
{
	if (bt_cb->bt_connected) {
		bt_cb->bt_connected(addr, err);
	}
}

static void disconnected_evt(const bt_addr_le_t *addr, u8_t err)
{
	if (bt_cb->bt_disconnected) {
		bt_cb->bt_disconnected(addr, err);
	}
}

static void bt_received_evt(const bt_addr_le_t *addr, const u8_t *data,
			    size_t length)
{
	if (bt_cb->bt_received) {
		bt_cb->bt_received(addr, data, length);
	}
}

static int ble_evt(CborValue *value, void *handler_data)
{
	CborError err;
        u8_t data[BT_NUS_MAX_DATA_SIZE];
	bt_addr_le_t addr;
	size_t data_len = sizeof(data);
	size_t addr_len = BT_ADDR_SIZE;
	int evt = (int)handler_data;

	err = cbor_value_get_simple_type(value, &addr.type);
	if (err != CborNoError) {
		goto cbor_error_exit;
	}

	err = cbor_value_advance_fixed(value);
	if (err != CborNoError) {
		goto cbor_error_exit;
	}

	err = cbor_value_copy_byte_string(value, addr.a.val,
					  &addr_len, value);
	if (err != CborNoError) {
		goto cbor_error_exit;
	}

	err = cbor_value_copy_byte_string(value, data,
					  &data_len, value);
	if (err != CborNoError) {
		goto cbor_error_exit;
	}

	LOG_DBG("Event: 0x%02x", evt);

	switch (evt) {
	case SER_EVT_CONNECTED:
		if (data_len != 1) {
			goto cbor_error_exit;
		}

		connected_evt(&addr, data[0]);

		break;

	case SER_EVT_DISCONNECTED:
		if (data_len != 1) {
			goto cbor_error_exit;
		}

		disconnected_evt(&addr, data[0]);

		break;

	case SER_EVT_NUS_RECEIVED:
		if (data_len < 1) {
			goto cbor_error_exit;
		}

		bt_received_evt(&addr, data, data_len);

		break;

	default:
		nrf_rpc_decoding_done();
		return NRF_RPC_ERR_NOT_SUPPORTED;
	}

	nrf_rpc_decoding_done();
	return NRF_RPC_SUCCESS;

cbor_error_exit:
	nrf_rpc_decoding_done();
	return NRF_RPC_ERR_OS_ERROR;
}

void bt_nus_callback_register(const struct bt_nus_cb *cb)
{
	if (!cb) {
		return;
	}

	bt_cb = cb;
}

int bt_nus_init(void)
{
	int result;
	int err;
	CborEncoder *encoder;
	struct nrf_rpc_cbor_cmd_ctx ctx;

	NRF_RPC_CBOR_CMD_ALLOC(ctx, &entropy_group, encoder, CBOR_BUF_SIZE, return -ENOMEM);

	err = nrf_rpc_cbor_cmd_send(&ctx, SER_COMMAND_NUS_INIT, rsp_error_code_handle, &result);
	if (err != NRF_RPC_SUCCESS) {
		return -EINVAL;
	}

	return result;
}

int bt_nus_transmit(const u8_t *data, size_t length)
{
	int result;
	int err;
	CborEncoder *encoder;
	struct nrf_rpc_cbor_cmd_ctx ctx;;

	if (!data || length < 1) {
		return -EINVAL;
	}

	NRF_RPC_CBOR_CMD_ALLOC(ctx, &entropy_group, encoder, CBOR_BUF_SIZE, return -ENOMEM);

	if (cbor_encode_byte_string(encoder, data, length) !=
	    CborNoError) {
		return -EINVAL;
	}

	err = nrf_rpc_cbor_cmd_send(&ctx, SER_COMMAND_NUS_SEND, rsp_error_code_handle, &result);
	if (err != NRF_RPC_SUCCESS) {
		return -EINVAL;
	}

	return result;
}

static int serialization_init(struct device *dev)
{
	ARG_UNUSED(dev);

	int err;

	printk("Init begin\n");

	err = nrf_rpc_init();
	if (err) {
		return -EINVAL;
	}

	printk("Init done\n");

	return 0;
}

NRF_RPC_CBOR_EVT_DECODER(entropy_group, connected, SER_EVT_CONNECTED, ble_evt, (void *)SER_EVT_CONNECTED);
NRF_RPC_CBOR_EVT_DECODER(entropy_group, disconnected, SER_EVT_DISCONNECTED, ble_evt, (void *)SER_EVT_DISCONNECTED);
NRF_RPC_CBOR_EVT_DECODER(entropy_group, nus_received, SER_EVT_NUS_RECEIVED, ble_evt, (void *)SER_EVT_NUS_RECEIVED);

SYS_INIT(serialization_init, POST_KERNEL, CONFIG_APPLICATION_INIT_PRIORITY);
```

## src/serialization.h
```c
/*
 * Copyright (c) 2020 Nordic Semiconductor ASA
 *
 * SPDX-License-Identifier: Apache-2.0
 */

#ifndef SERIALIZATION_H_
#define SERIALIZATION_H_

#include <bluetooth/addr.h>

/**
 * @file
 * @defgroup bt_serialization BLE Nordic UART Service serialization
 * @{
 * @brief BLE Nordic UART(NUS) serialization API.
 */

#ifdef __cplusplus
extern "C" {
#endif

/**@brief Callback structure used bt the BT NUS serialization. */
struct bt_nus_cb {
	/**@brief A new connection has been established on the Network core.
	 *
	 * This callback inform the Application core about a new
	 * connection.
	 *
	 * @param[in] addr Address of connected device.
	 * @param[in] err HCI error. Zero for success, non-zero otherwise.
	 */
	void (*bt_connected)(const bt_addr_le_t *addr, u8_t err);

	/**@brief A connection has been terminated on the Remote core.
	 *
	 * This callback notifies an Application core that a
	 * connection has been disconnected.
	 *
	 * @param[in] addr Address of connected device.
	 * @param[in] reason HCI reason for the disconnection.
	 */
	void (*bt_disconnected)(const bt_addr_le_t *addr, u8_t reason);

	/**@brief A new NUS data has been received on the remote core.
	 *
	 * This callback notifies a application processor that the Nordic\
	 * UART Service received new data.
	 *
	 * @param[in] addr Device address which sent data.
	 * @param[in] data Received NUS data.
	 * @param[in] lem data length.
	 */
	void (*bt_received)(const bt_addr_le_t *addr, const u8_t *data,
			    size_t len);
};

/**@brief Register bluetooth application callback.
 *
 * @param[in] cb Callback structure
 */
void bt_nus_callback_register(const struct bt_nus_cb *cb);

/**@brief Initialize Bluetooth NUS service on the Network
 *        core.
 *
 * @retval 0 If the operation was successful.
 *           Otherwise, a (negative) error code is returned.
 */
int bt_nus_init(void);

/**@brief Send received Nordic UART Service (NUS) to
 *        application processor.
 *
 * This function sends data to remote core and
 * wait a specific amount of time for remote function
 * call return value. On remote processor function
 * for sending data over NUS is called.
 *
 * @param[in] data NUS data to send.
 * @param[in] length Data length.
 *
 * @retval 0 If the operation was successful.
 *           Otherwise, a (negative) error code is returned.
 */
int bt_nus_transmit(const u8_t *data, size_t length);

#ifdef __cplusplus
}
#endif

/**
 *@}
 */

#endif /* SERIALIZATION_H_ */
```
