## sample.yaml
```
sample:
  name: nRF RPC host for BLE API
  description: nRF RPC host providing BLE API access
tests:
  samples.bluetooth.rpc_host:
    build_only: true
    build_on_all: true
    platform_allow: nrf5340dk_nrf5340_cpunet nrf5340pdk_nrf5340_cpunet
    tags: bluetooth ci_build
```

## prj.conf
```kconfig
#
# Copyright (c) 2021 Nordic Semiconductor
#
# SPDX-License-Identifier: LicenseRef-Nordic-5-Clause
#

CONFIG_BT_RPC=y
CONFIG_BT_RPC_HOST=y
CONFIG_BT_BROADCASTER=y
CONFIG_BT_ECC=n
# BT Device name must be the same like on the client side
CONFIG_BT_DEVICE_NAME="Test beacon"


CONFIG_SYSTEM_WORKQUEUE_STACK_SIZE=4096
CONFIG_HEAP_MEM_POOL_SIZE=4096
CONFIG_NRF_RPC_THREAD_STACK_SIZE=4096

# Options for better debugging
#CONFIG_LOG=y
#CONFIG_NRF_RPC_LOG_LEVEL_DBG=y
#CONFIG_NRF_RPC_TR_LOG_LEVEL_DBG=y
#CONFIG_NRF_RPC_OS_LOG_LEVEL_DBG=y
#CONFIG_BT_RPC_LOG_LEVEL_DBG=y

#CONFIG_NO_OPTIMIZATIONS=y
#CONFIG_DEBUG_OPTIMIZATIONS=y
#CONFIG_DEBUG=y

#CONFIG_HW_STACK_PROTECTION=y
```

## src/main.c
```c
/*
 * Copyright (c) 2021 Nordic Semiconductor ASA
 *
 * SPDX-License-Identifier: LicenseRef-Nordic-5-Clause
 */

#include <sys/printk.h>

void main(void)
{
	printk("Starting nRF PRC bluetooth host\n");
}
```
