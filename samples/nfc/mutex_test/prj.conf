## CMakeLists.txt
```
#
# Copyright (c) 2018 Nordic Semiconductor
#
# SPDX-License-Identifier: LicenseRef-BSD-5-Clause-Nordic
#

cmake_minimum_required(VERSION 3.8.2)

include($ENV{ZEPHYR_BASE}/cmake/app/boilerplate.cmake NO_POLICY_SCOPE)
project(NONE)

FILE(GLOB app_sources src/*.c)
# NORDIC SDK APP START
target_sources(app  PRIVATE ${app_sources})
# NORDIC SDK APP END
```

## sample.yaml
```
sample:
  description: My test
  name: my-test
tests:
  test_build:
    build_only: true
    build_on_all: true
    platform_whitelist: nrf52840_pca10056
    tags: ci_build
```

## prj.conf
```kconfig
#
# Copyright (c) 2019 Nordic Semiconductor ASA
#
# SPDX-License-Identifier: LicenseRef-BSD-5-Clause-Nordic
#
CONFIG_DK_LIBRARY=y
CONFIG_NRFXLIB_CRYPTO=y
CONFIG_NORDIC_SECURITY_BACKEND=y
CONFIG_MBEDTLS_VANILLA_BACKEND=y
CONFIG_MBED_X509_LIBRARY=y
CONFIG_MBED_TLS_LIBRARY=y
CONFIG_VANILLA_MBEDTLS_AES_C=y
CONFIG_VANILLA_MBEDTLS_CIPHER_MODE_CBC=y
CONFIG_VANILLA_MBEDTLS_CIPHER_MODE_CTR=y
CONFIG_VANILLA_MBEDTLS_CMAC_C=y
CONFIG_CC310_MBEDTLS_DHM_C=y
CONFIG_VANILLA_MBEDTLS_DHM_C=y
CONFIG_CC310_MBEDTLS_ECDH_C=y
CONFIG_VANILLA_MBEDTLS_ECDH_C=y
CONFIG_CC310_MBEDTLS_ECDSA_C=y
CONFIG_VANILLA_MBEDTLS_ECDSA_C=y
CONFIG_FP_HARDABI=y
CONFIG_FLOAT=y
```

## src/main.c
```c
/*
 * Copyright (c) 2018 Nordic Semiconductor ASA
 *
 * SPDX-License-Identifier: LicenseRef-BSD-5-Clause-Nordic
 */

#include <zephyr.h>
#include <misc/printk.h>

#include <dk_buttons_and_leds.h>

//		dk_set_led_on(DK_LED1);


#include <mbedtls/sha256.h>
#include <mbedtls/platform.h>

static unsigned char hash[32];
mbedtls_platform_context ctx;

int main(void)
{
	int r;
	if (dk_leds_init() < 0) {
		printk("Cannot init LEDs!\n");
		return 1;
	}
	printk("START\n");
	nrf_cc310_platform_abort_init();
	nrf_cc310_platform_mutex_init();
	r = mbedtls_platform_setup(&ctx);
	if (r != 0) printk("Error %d at %d\n", r, __LINE__);
	r = mbedtls_sha256_ret("Hello World!", 12, hash, 0);
	if (r != 0) printk("Error %d at %d\n", r, __LINE__);
	for (r = 0; r < sizeof(hash); r++)
	{
		printk("%02X ", hash[r]);
	}
	printk("\nEND\n");
	return 0;
}
```
